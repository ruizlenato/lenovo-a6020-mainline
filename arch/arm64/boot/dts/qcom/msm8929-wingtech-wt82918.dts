// SPDX-License-Identifier: GPL-2.0-only

/dts-v1/;

#include "msm8939-wingtech-wt82918.dtsi"

/ {
	model = "Lenovo Vibe K5 (Wingtech WT82918)";
	compatible = "wingtech,wt82918", "qcom,msm8929";
	chassis-type = "handset";
};

&blsp_i2c5 {
	touchscreen@38 {
		touchscreen-size-x = <720>;
		touchscreen-size-y = <1280>;
	};
};

/* MSM8929 GPU clocks up to 465MHz */
&opp_table {
	/delete-node/ opp-550000000;
};
